## src/afton-smartwheels/main/Kconfig.projbuild
```kconfig
menu "Example Configuration"

    orsource "$IDF_PATH/examples/common_components/env_caps/$IDF_TARGET/Kconfig.env_caps"

    choice BLINK_LED
        prompt "Blink LED type"
        default BLINK_LED_GPIO if IDF_TARGET_ESP32 || IDF_TARGET_ESP32C2
        default BLINK_LED_STRIP
        help
            Select the LED type. A normal level controlled LED or an addressable LED strip.
            The default selection is based on the Espressif DevKit boards.
            You can change the default selection according to your board.

        config BLINK_LED_GPIO
            bool "GPIO"
        config BLINK_LED_STRIP
            bool "LED strip"
    endchoice

    choice BLINK_LED_STRIP_BACKEND
        depends on BLINK_LED_STRIP
        prompt "LED strip backend peripheral"
        default BLINK_LED_STRIP_BACKEND_RMT if SOC_RMT_SUPPORTED
        default BLINK_LED_STRIP_BACKEND_SPI
        help
            Select the backend peripheral to drive the LED strip.

        config BLINK_LED_STRIP_BACKEND_RMT
            depends on SOC_RMT_SUPPORTED
            bool "RMT"
        config BLINK_LED_STRIP_BACKEND_SPI
            bool "SPI"
    endchoice

    config BLINK_GPIO
        int "Blink GPIO number"
        range ENV_GPIO_RANGE_MIN ENV_GPIO_OUT_RANGE_MAX
        default 5 if IDF_TARGET_ESP32
        default 18 if IDF_TARGET_ESP32S2
        default 48 if IDF_TARGET_ESP32S3
        default 8
        help
            GPIO number (IOxx) to blink on and off the LED.
            Some GPIOs are used for other purposes (flash connections, etc.) and cannot be used to blink.

    config BLINK_PERIOD
        int "Blink period in ms"
        range 10 3600000
        default 1000
        help
            Define the blinking period in milliseconds.


    menu "WiFi Setting"

        config ESP_WIFI_SSID
            string "WiFi SSID"
            default "myssid"
            help
                SSID (network name) to connect to.

        config ESP_WIFI_PASSWORD
            string "WiFi Password"
            default "mypassword"
            help
                WiFi password (WPA or WPA2) to connect to.

        config ESP_MAXIMUM_RETRY
            int "Maximum retry"
            default 5
            help
                Set the Maximum retry to avoid station reconnecting to the AP unlimited when the AP is really inexistent.

        config MDNS_HOSTNAME
            string "mDNS Hostname"
            default "esp32-camera"
            help
                The mDNS host name used by the ESP32.

        config STATIC_IP
            bool "Enable Static IP Address"
            default false
            help
                Enable Static IP Address.

        config STATIC_IP_ADDRESS
            depends on STATIC_IP
            string "Static IP Address"
            default "192.168.10.100"
            help
                Static IP Address for Station.

        config STATIC_GW_ADDRESS
            depends on STATIC_IP
            string "Static GW Address"
            default "192.168.10.1"
            help
                Static GW Address for Station.

        config STATIC_NM_ADDRESS
            depends on STATIC_IP
            string "Static Netmask"
            default "255.255.255.0"
            help
                Static Netmask for Station.
    endmenu


    choice BOARD
        bool "Select Board"
        default BOARD_ESP32CAM_AITHINKER
        help
            Select Board Type.

        config BOARD_ESP32_WROVER_FREENOVE
            bool "Freenove ESP32-WROVER CAM Board"
        config BOARD_ESP32S3_WROOM_FREENOVE
            bool "Freenove ESP32S3-WROOM CAM Board"
        config BOARD_CAMERA_MODEL_ESP_EYE
            bool "Espressif ESP-EYE"
        config BOARD_ESP32CAM_AITHINKER
            bool "AiThinker ESP32-CAM"
        config BOARD_CAMERA_MODEL_TTGO_T_JOURNAL
            bool "TTGO T-Journal ESP32 Camera"
        config BOARD_ESPS3_CAM_UICPAL
            bool "UICPAL ESPS3 CAM RE:1.0"
    endchoice

    config ENABLE_FLASH
        bool "Enable Flash Light"
        default n
        help
            Enable Flash Light.

    config GPIO_FLASH
        int "Flash GPIO number"
        depends on ENABLE_FLASH
        range 4 34
        default 4
        help
            GPIO number (IOxx) to Button Input.
            Some GPIOs are used for other purposes (flash connections, etc.) and cannot be used to Button.

endmenu
```
